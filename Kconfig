## Kconfig
```kconfig
mainmenu "ZMK config root module"

menu "Sofle local modules"

config ZMK_BEHAVIOR_OLED_TOGGLE
    bool "Behavior to toggle the local half's OLED display"
    default y

config SOFLE_STATUS_SCREEN
    bool "Minimal static status screen for classic Sofle SSD1306"
    depends on ZMK_DISPLAY && (SHIELD_SOFLE_LEFT || SHIELD_SOFLE_RIGHT)
    select LV_USE_IMAGE
    select LV_USE_THEME_MONO
    default n

config SOFLE_STATUS_BATTERY_SETTLE_MS
    int "Wait after USB removal before accepting a local battery estimate"
    depends on SOFLE_STATUS_SCREEN
    default 3000
    range 1000 30000

config SOFLE_STATUS_BATTERY_INTERVAL_MS
    int "Local OLED battery sampling interval while active on battery"
    depends on SOFLE_STATUS_SCREEN
    default 60000
    range 10000 300000

config SOFLE_MAC1_BT_PROFILE
    int "BT profile index for MAC1"
    depends on SOFLE_STATUS_SCREEN
    default 0
    range 0 4

config SOFLE_MAC2_BT_PROFILE
    int "BT profile index for MAC2"
    depends on SOFLE_STATUS_SCREEN
    default 1
    range 0 4

config SOFLE_DONGLE_BT_PROFILE
    int "BT profile index for optional HID bridge"
    depends on SOFLE_STATUS_SCREEN
    default 4
    range 0 4

config SOFLE_ZOOM_TAP_MS
    int "Recipient-pinned browser zoom pulse duration"
    depends on SOFLE_STATUS_SCREEN && ZMK_SPLIT_ROLE_CENTRAL
    default 5
    range 1 30

endmenu
```

## bridge/boards/sofle/bridge_nano/Kconfig.bridge_nano
```kconfig
# SPDX-License-Identifier: MIT
config BOARD_BRIDGE_NANO
    select SOC_NRF52840_QIAA
```

## bridge/boards/sofle/bridge_nano/board.yml
```yaml
board:
  name: bridge_nano
  full_name: Unapproved USB-only nice-nano-compatible bridge candidate
  vendor: others
  socs:
    - name: nrf52840
```

## bridge/boards/sofle/bridge_nano/bridge_nano_defconfig
```kconfig
# SPDX-License-Identifier: MIT
CONFIG_ARM_MPU=y
CONFIG_MPU_ALLOW_FLASH_WRITE=y
CONFIG_CLOCK_CONTROL_NRF_K32SRC_RC=y
CONFIG_CLOCK_CONTROL_NRF_K32SRC_500PPM=y
```

## config/west.yml
```yaml
manifest:
  remotes:
    - name: zmkfirmware
      url-base: https://github.com/zmkfirmware
    - name: cormoran
      url-base: https://github.com/cormoran
    - name: englmaxi
      url-base: https://github.com/englmaxi
    - name: mctechnology17
      url-base: https://github.com/mctechnology17
    - name: statix05
      url-base: https://github.com/statix05
  projects:
    # Coherent main+dya stack: Zephyr 4.1 + LVGL 9.3 + custom Studio protocol.
    - name: zmk
      remote: statix05
      revision: 579892a97804c56d9264519bfe5e28ed4b851d8b
      import: app/west.yml
    # Exact revision of the Zephyr branch selected by this core, not latest SDK.
    - name: zephyr
      remote: zmkfirmware
      revision: 10ba6d0cb38bc3d258775d27982f707599320085
      clone-depth: 1
      import:
        name-blocklist:
          - ci-tools
          - hal_altera
          - hal_cypress
          - hal_infineon
          - hal_microchip
          - hal_nxp
          - hal_openisa
          - hal_xtensa
          - hal_st
          - hal_ti
          - loramac-node
          - mcuboot
          - mcumgr
          - net-tools
          - openthread
          - edtt
          - trusted-firmware-m
    # No Zephyr-3.5 compatibility fork is necessary on the modern stack.
    - name: zmk-feature-custom-settings
      remote: cormoran
      revision: c6a7fef3a3be3d3ace5de9a4b0628c6418cd1f3f
    - name: zmk-feature-runtime-macro
      remote: cormoran
      revision: 38530962eb7061b60efcb98e84585cfb1f0cb6de
      import: true
    - name: zmk-feature-runtime-combo
      remote: cormoran
      revision: d9490e7b5d41c516221d131241009e81740efcee
      import: true
    - name: zmk-module-settings-rpc
      remote: cormoran
      revision: 78f86df9e6c5edaf57bef3ccbd7f360cfdf49291
    - name: zmk-module-ble-management
      remote: cormoran
      revision: 57738cc4fc6ba80e82a7ac57741a0339cb186cd4
    - name: zmk-module-battery-history
      remote: cormoran
      revision: 307755dd2ad4d320e14de162e8e5ef018f29d929
    - name: zmk-behavior-runtime-sensor-rotate
      remote: cormoran
      revision: 8b1125ed676c1f5e14145d217984f33d0ebdcef4
    - name: zmk-feature-module-physical-layout
      remote: cormoran
      revision: 4f18de45dc27820725d267916b4cdacc0e0b6cf9
    - name: zmk-feature-input-stream
      remote: cormoran
      revision: aeb015908a42a7615ccdccc7feb3a10d23132a71
    # Retained for other template configurations, NOT selected by Sofle builds.
    - name: zmk-dongle-display
      remote: englmaxi
      revision: c6c4be11c5ede722086a2a1f355cec9c101b9390
    - name: zmk-nice-oled
      remote: statix05
      revision: 6c0cf35b7311d8e5950ea5826035cb78fce2f83f
    - name: zmk-dongle-display-view
      remote: mctechnology17
      revision: 05bf62b4ee0858cd8801b07aa6cc6716d210932d
    - name: zmk-oled-adapter
      remote: mctechnology17
      revision: 892c83d60b6a365c35334c06831d9c5b0f2ba9c0
  self:
    path: config
```

## dts/bindings/behaviors/statix,profile-zoom.yaml
```yaml
description: Recipient-pinned browser zoom selected by configured BT profile
compatible: "statix,profile-zoom"
include: one_param.yaml
```

## zmk-oled-toggle/Kconfig
```kconfig
mainmenu "ZMK OLED Toggle"

menu "ZMK OLED Toggle"

config ZMK_BEHAVIOR_OLED_TOGGLE
    bool "Behavior to toggle the local half's OLED display"
    default y

endmenu
```

## zmk-oled-toggle/dts/bindings/zmk,behavior-oled-toggle.yaml
```yaml
description: Toggle the local half's OLED display on/off

compatible: "zmk,behavior-oled-toggle"

include: zero_param.yaml
```
